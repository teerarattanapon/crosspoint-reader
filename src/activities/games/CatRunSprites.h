#pragma once

#include <GfxRenderer.h>

#include <cstdint>

#include "CatRunSaveStore.h"
#include "catrun_sprites/BULLY_COOL.h"
#include "catrun_sprites/BULLY_MUSCLE.h"
#include "catrun_sprites/BRICK.h"
#include "catrun_sprites/BUSH.h"
#include "catrun_sprites/CAT_BLACK_DUCK.h"
#include "catrun_sprites/CAT_BLACK_JUMP.h"
#include "catrun_sprites/CAT_BLACK_WALK0.h"
#include "catrun_sprites/CAT_BLACK_WALK1.h"
#include "catrun_sprites/CAT_BLACK_WALK2.h"
#include "catrun_sprites/CAT_CALICO_DUCK.h"
#include "catrun_sprites/CAT_CALICO_JUMP.h"
#include "catrun_sprites/CAT_CALICO_WALK0.h"
#include "catrun_sprites/CAT_CALICO_WALK1.h"
#include "catrun_sprites/CAT_CALICO_WALK2.h"
#include "catrun_sprites/CAT_WHITE_DUCK.h"
#include "catrun_sprites/CAT_WHITE_JUMP.h"
#include "catrun_sprites/CAT_WHITE_WALK0.h"
#include "catrun_sprites/CAT_WHITE_WALK1.h"
#include "catrun_sprites/CAT_WHITE_WALK2.h"
#include "catrun_sprites/CLOUD.h"
#include "catrun_sprites/CLOUD_1.h"
#include "catrun_sprites/CLOUD_2.h"
#include "catrun_sprites/CLOUD_3.h"
#include "catrun_sprites/CRATE.h"
#include "catrun_sprites/CROW_0.h"
#include "catrun_sprites/CROW_1.h"
#include "catrun_sprites/DEAD_TREE_BOSS.h"
#include "catrun_sprites/DOG_RUN0.h"
#include "catrun_sprites/DOG_RUN1.h"
#include "catrun_sprites/DOG_RUN2.h"
#include "catrun_sprites/DOG_RUN3.h"
#include "catrun_sprites/DRIED_FISH.h"
#include "catrun_sprites/FENCE.h"
#include "catrun_sprites/FINISH_FLAG.h"
#include "catrun_sprites/FOOD_CAN.h"
#include "catrun_sprites/MOUNTAIN.h"
#include "catrun_sprites/MOUNTAIN_1.h"
#include "catrun_sprites/MOUNTAIN_2.h"
#include "catrun_sprites/MINE.h"
#include "catrun_sprites/BG_TREE_A.h"
#include "catrun_sprites/BG_TREE_B.h"
#include "catrun_sprites/FROG_0.h"
#include "catrun_sprites/FROG_1.h"
#include "catrun_sprites/FROG_2.h"
#include "catrun_sprites/PLATFORM.h"
#include "catrun_sprites/PINE_WATER.h"
#include "catrun_sprites/PUDDLE_0.h"
#include "catrun_sprites/PUDDLE_1.h"
#include "catrun_sprites/PUDDLE_2.h"
#include "catrun_sprites/PUDDLE_3.h"
#include "catrun_sprites/QBLOCK.h"
#include "catrun_sprites/ROBOT_DEFEATED.h"
#include "catrun_sprites/ROBOT_DROP.h"
#include "catrun_sprites/ROBOT_MINE_POSE.h"
#include "catrun_sprites/ROBOT_ROAR.h"
#include "catrun_sprites/ROBOT_STAND.h"
#include "catrun_sprites/ROCKET.h"
#include "catrun_sprites/SNAKE_0.h"
#include "catrun_sprites/SNAKE_1.h"
#include "catrun_sprites/SNAKE_2.h"
#include "catrun_sprites/SNAKE_3.h"
#include "catrun_sprites/SPIKE_PIT.h"
#include "catrun_sprites/TREE.h"
#include "catrun_sprites/WATER.h"

/**
 * Flash-resident 1-bit Cat Run sprites (generated by scripts/gen_catrun_sprites.py).
 * Bit convention: 0 = black (draw), 1 = transparent. Drawn via scaled fillRect so
 * sprites stay readable on e-ink FAST_REFRESH (~1–3 FPS).
 */
namespace CatRunSprites {

using EntityKind = CatRunSaveStore::EntityKind;

enum class CatColor : uint8_t { White = 0, Black = 1, Calico = 2 };

/** Background tree set from game.pdf time windows. */
enum class ScenePhase : uint8_t {
  Leafy = 0,  // default (all except pine/boss windows)
  Pine = 1,   // 01:06–01:30
  Dead = 2,   // 02:21–03:00 boss
};

static constexpr int PIXEL_SCALE = 2;
static constexpr int SPRITE_SRC = 32;
static constexpr int SPRITE_DRAW = SPRITE_SRC * PIXEL_SCALE;  // 64
static constexpr int CAT_DRAW = SPRITE_DRAW;

inline ScenePhase scenePhaseFromSec(uint32_t sec, uint32_t gameDurationSec, uint32_t bossPhaseSec) {
  if (sec + bossPhaseSec >= gameDurationSec) {
    return ScenePhase::Dead;
  }
  if (sec >= 66 && sec < 91) {
    return ScenePhase::Pine;
  }
  return ScenePhase::Leafy;
}

struct SpriteRef {
  const uint8_t* data;
  int w;
  int h;
};

inline SpriteRef walkFrameSprite(const uint8_t* d0, int w0, int h0, const uint8_t* d1, int w1, int h1,
                                 const uint8_t* d2, int w2, int h2, uint8_t walkFrame) {
  switch (walkFrame % 3u) {
    case 1:
      return {d1, w1, h1};
    case 2:
      return {d2, w2, h2};
    case 0:
    default:
      return {d0, w0, h0};
  }
}

inline void blit1BitTransparent(GfxRenderer& r, int x, int y, const SpriteRef& spr, int scale = PIXEL_SCALE) {
  if (!spr.data || spr.w <= 0 || spr.h <= 0 || scale <= 0) {
    return;
  }
  const int rowBytes = spr.w / 8;
  const int sw = r.getScreenWidth();
  const int sh = r.getScreenHeight();
  for (int row = 0; row < spr.h; ++row) {
    for (int col = 0; col < spr.w; ++col) {
      const uint8_t byte = spr.data[row * rowBytes + (col / 8)];
      const uint8_t bit = static_cast<uint8_t>(0x80u >> (col % 8));
      if ((byte & bit) != 0) {
        continue;  // white / transparent
      }
      const int px = x + col * scale;
      const int py = y + row * scale;
      if (px < 0 || py < 0 || px + scale > sw || py + scale > sh) {
        continue;
      }
      r.fillRect(px, py, scale, scale, true);
    }
  }
}

/** Nearest-neighbor 1-bit blit to an arbitrary destination size (no heap). */
inline void blit1BitToSize(GfxRenderer& r, int x, int y, const SpriteRef& spr, int dw, int dh) {
  if (!spr.data || spr.w <= 0 || spr.h <= 0 || dw <= 0 || dh <= 0) {
    return;
  }
  const int rowBytes = spr.w / 8;
  const int sw = r.getScreenWidth();
  const int sh = r.getScreenHeight();
  for (int dy = 0; dy < dh; ++dy) {
    const int sy = dy * spr.h / dh;
    const int py = y + dy;
    if (py < 0 || py >= sh) {
      continue;
    }
    for (int dx = 0; dx < dw; ++dx) {
      const int sx = dx * spr.w / dw;
      const uint8_t byte = spr.data[sy * rowBytes + (sx / 8)];
      const uint8_t bit = static_cast<uint8_t>(0x80u >> (sx % 8));
      if ((byte & bit) != 0) {
        continue;  // white / transparent
      }
      const int px = x + dx;
      if (px < 0 || px >= sw) {
        continue;
      }
      r.fillRect(px, py, 1, 1, true);
    }
  }
}

inline void blitTiled(GfxRenderer& r, int x, int y, int w, int h, const SpriteRef& spr) {
  const int tile = spr.w * PIXEL_SCALE;
  if (tile <= 0) {
    return;
  }
  for (int ox = 0; ox < w; ox += tile) {
    blit1BitTransparent(r, x + ox, y + (h - spr.h * PIXEL_SCALE), spr);
  }
}

inline SpriteRef catSprite(CatColor color, uint8_t walkFrame, bool jumping, bool ducking) {
  switch (color) {
    case CatColor::Black:
      if (ducking) {
        return {CAT_BLACK_DUCK, CAT_BLACK_DUCK_W, CAT_BLACK_DUCK_H};
      }
      if (jumping) {
        return {CAT_BLACK_JUMP, CAT_BLACK_JUMP_W, CAT_BLACK_JUMP_H};
      }
      return walkFrameSprite(CAT_BLACK_WALK0, CAT_BLACK_WALK0_W, CAT_BLACK_WALK0_H, CAT_BLACK_WALK1,
                             CAT_BLACK_WALK1_W, CAT_BLACK_WALK1_H, CAT_BLACK_WALK2, CAT_BLACK_WALK2_W,
                             CAT_BLACK_WALK2_H, walkFrame);
    case CatColor::Calico:
      if (ducking) {
        return {CAT_CALICO_DUCK, CAT_CALICO_DUCK_W, CAT_CALICO_DUCK_H};
      }
      if (jumping) {
        return {CAT_CALICO_JUMP, CAT_CALICO_JUMP_W, CAT_CALICO_JUMP_H};
      }
      return walkFrameSprite(CAT_CALICO_WALK0, CAT_CALICO_WALK0_W, CAT_CALICO_WALK0_H, CAT_CALICO_WALK1,
                             CAT_CALICO_WALK1_W, CAT_CALICO_WALK1_H, CAT_CALICO_WALK2, CAT_CALICO_WALK2_W,
                             CAT_CALICO_WALK2_H, walkFrame);
    case CatColor::White:
    default:
      if (ducking) {
        return {CAT_WHITE_DUCK, CAT_WHITE_DUCK_W, CAT_WHITE_DUCK_H};
      }
      if (jumping) {
        return {CAT_WHITE_JUMP, CAT_WHITE_JUMP_W, CAT_WHITE_JUMP_H};
      }
      return walkFrameSprite(CAT_WHITE_WALK0, CAT_WHITE_WALK0_W, CAT_WHITE_WALK0_H, CAT_WHITE_WALK1,
                             CAT_WHITE_WALK1_W, CAT_WHITE_WALK1_H, CAT_WHITE_WALK2, CAT_WHITE_WALK2_W,
                             CAT_WHITE_WALK2_H, walkFrame);
  }
}

inline void drawCat(GfxRenderer& r, int x, int y, CatColor color, uint8_t walkFrame, bool jumping, bool ducking) {
  const SpriteRef spr = catSprite(color, walkFrame, jumping, ducking);
  // Wider white run frames (40px) stay centered on the 64px gameplay slot.
  const int ox = (CAT_DRAW - spr.w * PIXEL_SCALE) / 2;
  const int oy = CAT_DRAW - spr.h * PIXEL_SCALE;
  blit1BitTransparent(r, x + ox, y + oy, spr);
}

inline SpriteRef entitySprite(EntityKind kind) {
  switch (kind) {
    case EntityKind::Hole:
      return {SPIKE_PIT, SPIKE_PIT_W, SPIKE_PIT_H};
    case EntityKind::Water:
      return {WATER, WATER_W, WATER_H};
    case EntityKind::Grass:
      return {BUSH, BUSH_W, BUSH_H};
    case EntityKind::Tree:
      return {TREE, TREE_W, TREE_H};
    case EntityKind::Fence:
      return {FENCE, FENCE_W, FENCE_H};
    case EntityKind::Crate:
      return {CRATE, CRATE_W, CRATE_H};
    case EntityKind::Brick:
      return {BRICK, BRICK_W, BRICK_H};
    case EntityKind::QuestionBlock:
      return {QBLOCK, QBLOCK_W, QBLOCK_H};
    case EntityKind::Platform:
      return {PLATFORM, PLATFORM_W, PLATFORM_H};
    case EntityKind::Puppy:
    case EntityKind::Dog:
    case EntityKind::RunningDog:
      // Animated via dogSprite() in drawEntity.
      return {DOG_RUN0, DOG_RUN0_W, DOG_RUN0_H};
    case EntityKind::CoolCat:
      return {BULLY_COOL, BULLY_COOL_W, BULLY_COOL_H};
    case EntityKind::BullyCat:
      return {BULLY_MUSCLE, BULLY_MUSCLE_W, BULLY_MUSCLE_H};
    case EntityKind::CatFood:
      return {FOOD_CAN, FOOD_CAN_W, FOOD_CAN_H};
    case EntityKind::Fish:
      return {DRIED_FISH, DRIED_FISH_W, DRIED_FISH_H};
    case EntityKind::Flag:
      return {FINISH_FLAG, FINISH_FLAG_W, FINISH_FLAG_H};
    case EntityKind::Puddle:
      return {PUDDLE_0, PUDDLE_0_W, PUDDLE_0_H};
    case EntityKind::Frog:
      return {FROG_0, FROG_0_W, FROG_0_H};
    case EntityKind::Snake:
      return {SNAKE_0, SNAKE_0_W, SNAKE_0_H};
    case EntityKind::Crow:
      return {CROW_0, CROW_0_W, CROW_0_H};
    case EntityKind::Rocket:
      return {ROCKET, ROCKET_W, ROCKET_H};
    case EntityKind::Mine:
      return {MINE, MINE_W, MINE_H};
    default:
      return {CRATE, CRATE_W, CRATE_H};
  }
}

inline SpriteRef dogSprite(uint8_t frame) {
  switch (frame & 3u) {
    case 1:
      return {DOG_RUN1, DOG_RUN1_W, DOG_RUN1_H};
    case 2:
      return {DOG_RUN2, DOG_RUN2_W, DOG_RUN2_H};
    case 3:
      return {DOG_RUN3, DOG_RUN3_W, DOG_RUN3_H};
    case 0:
    default:
      return {DOG_RUN0, DOG_RUN0_W, DOG_RUN0_H};
  }
}

inline SpriteRef puddleSprite(uint8_t frame) {
  switch (frame & 3u) {
    case 1:
      return {PUDDLE_1, PUDDLE_1_W, PUDDLE_1_H};
    case 2:
      return {PUDDLE_2, PUDDLE_2_W, PUDDLE_2_H};
    case 3:
      return {PUDDLE_3, PUDDLE_3_W, PUDDLE_3_H};
    case 0:
    default:
      return {PUDDLE_0, PUDDLE_0_W, PUDDLE_0_H};
  }
}

inline SpriteRef frogSprite(uint8_t frame) {
  switch (frame % 3u) {
    case 1:
      return {FROG_1, FROG_1_W, FROG_1_H};
    case 2:
      return {FROG_2, FROG_2_W, FROG_2_H};
    case 0:
    default:
      return {FROG_0, FROG_0_W, FROG_0_H};
  }
}

inline SpriteRef snakeSprite(uint8_t frame) {
  switch (frame & 3u) {
    case 1:
      return {SNAKE_1, SNAKE_1_W, SNAKE_1_H};
    case 2:
      return {SNAKE_2, SNAKE_2_W, SNAKE_2_H};
    case 3:
      return {SNAKE_3, SNAKE_3_W, SNAKE_3_H};
    case 0:
    default:
      return {SNAKE_0, SNAKE_0_W, SNAKE_0_H};
  }
}

inline SpriteRef crowSprite(uint8_t frame) {
  return (frame & 1u) ? SpriteRef{CROW_1, CROW_1_W, CROW_1_H} : SpriteRef{CROW_0, CROW_0_W, CROW_0_H};
}

/** How far a puddle sprite extends below its hitbox into the ground hatch. */
static constexpr int kPuddleGroundOverlap = 8;

/** Erase hatch under a filled ellipse (white = false). No heap; stack locals only. */
inline void fillEllipseWhite(GfxRenderer& r, int cx, int cy, int rx, int ry) {
  if (rx <= 0 || ry <= 0) {
    return;
  }
  const int sw = r.getScreenWidth();
  const int sh = r.getScreenHeight();
  const int ry2 = ry * ry;
  for (int dy = -ry; dy <= ry; ++dy) {
    const int y = cy + dy;
    if (y < 0 || y >= sh) {
      continue;
    }
    // x^2/rx^2 + y^2/ry^2 <= 1  →  half-width at this row
    const int64_t numer = static_cast<int64_t>(rx) * rx * (ry2 - dy * dy);
    if (numer <= 0) {
      continue;
    }
    // Integer sqrt of numer/ry2; use float-free binary search on halfW.
    int lo = 0;
    int hi = rx;
    while (lo < hi) {
      const int mid = (lo + hi + 1) / 2;
      if (static_cast<int64_t>(mid) * mid * ry2 <= numer) {
        lo = mid;
      } else {
        hi = mid - 1;
      }
    }
    const int halfW = lo;
    int x0 = cx - halfW;
    int x1 = cx + halfW;
    if (x1 < 0 || x0 >= sw) {
      continue;
    }
    if (x0 < 0) {
      x0 = 0;
    }
    if (x1 >= sw) {
      x1 = sw - 1;
    }
    r.fillRect(x0, y, x1 - x0 + 1, 1, false);
  }
}

/** Bottom-aligned puddle: white ellipse cutout then outline blit (scale 1). */
inline void drawPuddleVisual(GfxRenderer& r, int boxX, int boxY, int boxW, int boxH, const SpriteRef& spr) {
  constexpr int kScale = 1;
  constexpr int kInset = 2;
  const int dw = spr.w * kScale;
  const int dh = spr.h * kScale;
  const int ox = boxX + (boxW - dw) / 2;
  const int oy = boxY + (boxH - dh);
  const int rx = dw / 2 - kInset;
  const int ry = dh / 2 - kInset;
  if (rx > 0 && ry > 0) {
    fillEllipseWhite(r, ox + dw / 2, oy + dh / 2, rx, ry);
  }
  blit1BitTransparent(r, ox, oy, spr, kScale);
}

inline void blitBottom(GfxRenderer& r, int x, int y, int w, int h, const SpriteRef& spr) {
  const int dw = spr.w * PIXEL_SCALE;
  const int dh = spr.h * PIXEL_SCALE;
  const int ox = x + (w - dw) / 2;
  const int oy = y + (h - dh);
  blit1BitTransparent(r, ox, oy, spr);
}

inline void blitBottomScaled(GfxRenderer& r, int x, int y, int w, int h, const SpriteRef& spr, int scale) {
  const int dw = spr.w * scale;
  const int dh = spr.h * scale;
  const int ox = x + (w - dw) / 2;
  const int oy = y + (h - dh);
  blit1BitTransparent(r, ox, oy, spr, scale);
}

inline void drawEntity(GfxRenderer& r, EntityKind kind, int x, int y, int w, int h, uint8_t animFrame = 0,
                       ScenePhase scene = ScenePhase::Leafy, bool hideCreature = false) {
  switch (kind) {
    case EntityKind::Hole:
    case EntityKind::Water:
    case EntityKind::Platform:
    case EntityKind::Fence:
      blitTiled(r, x, y, w, h, entitySprite(kind));
      break;
    case EntityKind::Puppy:
    case EntityKind::Dog:
    case EntityKind::RunningDog:
      blitBottom(r, x, y, w, h, dogSprite(animFrame));
      break;
    case EntityKind::Crate:
      // 50% of prior PIXEL_SCALE=2 visual (32×2 → 32).
      blitBottomScaled(r, x, y, w, h, entitySprite(kind), 1);
      break;
    case EntityKind::CatFood:
      // 50% of prior PIXEL_SCALE=2 visual (40×2 → 40).
      blitBottomScaled(r, x, y, w, h, entitySprite(kind), 1);
      break;
    case EntityKind::Puddle:
      // Visual overlaps the ground band; collision still uses entity worldY above ground.
      drawPuddleVisual(r, x, y + kPuddleGroundOverlap, w, h, puddleSprite(animFrame));
      break;
    case EntityKind::Frog: {
      // Native 48×48 — avoid upscale that fattens 1px strokes on e-ink.
      constexpr int kFrogDraw = FROG_0_W;
      if (!hideCreature) {
        const SpriteRef spr = frogSprite(animFrame);
        const int ox = x + (w - kFrogDraw) / 2;
        const int oy = y + (h - kFrogDraw);
        blit1BitToSize(r, ox, oy, spr, kFrogDraw, kFrogDraw);
      }
      break;
    }
    case EntityKind::Snake: {
      constexpr int kSnakeDraw = SNAKE_0_W;
      if (!hideCreature) {
        const SpriteRef spr = snakeSprite(animFrame);
        const int ox = x + (w - kSnakeDraw) / 2;
        const int oy = y + (h - kSnakeDraw);
        blit1BitToSize(r, ox, oy, spr, kSnakeDraw, kSnakeDraw);
      }
      break;
    }
    case EntityKind::Fish: {
      // 75% of prior PIXEL_SCALE=2 visual (80×64 → 60×48).
      constexpr int kFishDrawW = DRIED_FISH_W * PIXEL_SCALE * 75 / 100;
      constexpr int kFishDrawH = DRIED_FISH_H * PIXEL_SCALE * 75 / 100;
      const SpriteRef spr = entitySprite(kind);
      const int ox = x + (w - kFishDrawW) / 2;
      const int oy = y + (h - kFishDrawH);
      blit1BitToSize(r, ox, oy, spr, kFishDrawW, kFishDrawH);
      break;
    }
    case EntityKind::Crow: {
      // +50% vs native 48×48 → 72px (readable duck hazard on e-ink).
      constexpr int kCrowDraw = CROW_0_W * 150 / 100;
      const SpriteRef spr = crowSprite(animFrame);
      const int ox = x + (w - kCrowDraw) / 2;
      const int oy = y + (h - kCrowDraw);
      blit1BitToSize(r, ox, oy, spr, kCrowDraw, kCrowDraw);
      break;
    }
    case EntityKind::Rocket: {
      // 75% of prior 60px draw → 45 (was 40×2×0.75).
      constexpr int kRocketDraw = ROCKET_W * PIXEL_SCALE * 75 / 100 * 75 / 100;
      const SpriteRef spr = entitySprite(kind);
      const int ox = x + (w - kRocketDraw) / 2;
      const int oy = y + (h - kRocketDraw);
      blit1BitToSize(r, ox, oy, spr, kRocketDraw, kRocketDraw);
      break;
    }
    case EntityKind::Mine:
      blitBottomScaled(r, x, y, w, h, entitySprite(kind), 1);
      break;
    case EntityKind::Tree: {
      // Scenery tree follows scene phase (game.pdf).
      SpriteRef tree = {BG_TREE_A, BG_TREE_A_W, BG_TREE_A_H};
      if (scene == ScenePhase::Pine) {
        tree = {PINE_WATER, PINE_WATER_W, PINE_WATER_H};
      } else if (scene == ScenePhase::Dead) {
        tree = {DEAD_TREE_BOSS, DEAD_TREE_BOSS_W, DEAD_TREE_BOSS_H};
      }
      blit1BitTransparent(r, x + (w - tree.w) / 2, y + h - tree.h, tree, 1);
      break;
    }
    default:
      blitBottom(r, x, y, w, h, entitySprite(kind));
      break;
  }
}

/** On-screen boss size (stand / mine-pose share one footprint). */
static constexpr int kBossIdleDraw = ROBOT_STAND_H * 75 * 135 / 10000;  // 72
static constexpr int kBossDraw = kBossIdleDraw;

inline int bossDrawSize(uint8_t /*pose*/) {
  return kBossIdleDraw;
}

/** Boss mech on the right. pose: 0=idle stand, 3=ROBOT_MINE_POSE (rocket warn/fire).
 *  idleAlt also shows the mine pose. */
inline void drawBossRobot(GfxRenderer& r, int screenX, int screenY, uint8_t pose, bool idleAlt = false) {
  const int drawSize = bossDrawSize(pose);
  // Desolate dead tree beside the mech (decorative scenery for boss phase).
  blit1BitTransparent(r, screenX - DEAD_TREE_BOSS_W - 4, screenY + drawSize - DEAD_TREE_BOSS_H,
                       {DEAD_TREE_BOSS, DEAD_TREE_BOSS_W, DEAD_TREE_BOSS_H}, 1);
  SpriteRef spr = {ROBOT_STAND, ROBOT_STAND_W, ROBOT_STAND_H};
  if (pose == 3 || idleAlt) {
    spr = {ROBOT_MINE_POSE, ROBOT_MINE_POSE_W, ROBOT_MINE_POSE_H};
  }
  blit1BitToSize(r, screenX, screenY, spr, drawSize, drawSize);
}

inline void drawBossDefeated(GfxRenderer& r, int screenX, int screenY) {
  blit1BitTransparent(r, screenX, screenY, {ROBOT_DEFEATED, ROBOT_DEFEATED_W, ROBOT_DEFEATED_H}, 1);
}

inline void drawParallax(GfxRenderer& r, int x, int y, int tileIndex = 0) {
  // Far background only: clouds + mountains (trees are a separate midground layer).
  constexpr int kCloudY = 8;  // sit under HUD — avoid clipping past top edge
  constexpr int kCloudScale = 1;
  constexpr int kMountainY = 48;  // under clouds (72×36 ×1)
  constexpr int kMountainScale = 2;

  static const SpriteRef kClouds[] = {
      {CLOUD, CLOUD_W, CLOUD_H},
      {CLOUD_1, CLOUD_1_W, CLOUD_1_H},
      {CLOUD_2, CLOUD_2_W, CLOUD_2_H},
      {CLOUD_3, CLOUD_3_W, CLOUD_3_H},
  };
  static const SpriteRef kMountains[] = {
      {MOUNTAIN, MOUNTAIN_W, MOUNTAIN_H},
      {MOUNTAIN_1, MOUNTAIN_1_W, MOUNTAIN_1_H},
      {MOUNTAIN_2, MOUNTAIN_2_W, MOUNTAIN_2_H},
  };
  const SpriteRef& cloud = kClouds[tileIndex % 4];
  const SpriteRef& mountain = kMountains[tileIndex % 3];

  blit1BitTransparent(r, x + 40, y + kCloudY, cloud, kCloudScale);
  blit1BitTransparent(r, x, y + kMountainY, mountain, kMountainScale);
}

/** Midground trees: above playfield / jump apex; larger than hazards.
 *  baseY = trunk feet. Scale 2 enlarges native 48×80 / 48×96 art. */
inline void drawMidgroundTrees(GfxRenderer& r, int x, int baseY, int tileIndex, ScenePhase scene) {
  constexpr int kTreeScale = 2;
  if (scene == ScenePhase::Pine) {
    blit1BitTransparent(r, x + 28, baseY - PINE_WATER_H * kTreeScale, {PINE_WATER, PINE_WATER_W, PINE_WATER_H},
                        kTreeScale);
    blit1BitTransparent(r, x + 100, baseY - PINE_WATER_H * kTreeScale + 8, {PINE_WATER, PINE_WATER_W, PINE_WATER_H},
                        kTreeScale);
  } else if (scene == ScenePhase::Dead) {
    blit1BitTransparent(r, x + 24, baseY - DEAD_TREE_BOSS_H * kTreeScale,
                        {DEAD_TREE_BOSS, DEAD_TREE_BOSS_W, DEAD_TREE_BOSS_H}, kTreeScale);
    blit1BitTransparent(r, x + 108, baseY - DEAD_TREE_BOSS_H * kTreeScale + 8,
                        {DEAD_TREE_BOSS, DEAD_TREE_BOSS_W, DEAD_TREE_BOSS_H}, kTreeScale);
  } else if ((tileIndex & 1) == 0) {
    blit1BitTransparent(r, x + 12, baseY - BG_TREE_A_H * kTreeScale, {BG_TREE_A, BG_TREE_A_W, BG_TREE_A_H},
                        kTreeScale);
    blit1BitTransparent(r, x + 72, baseY - BG_TREE_B_H * kTreeScale + 4, {BG_TREE_B, BG_TREE_B_W, BG_TREE_B_H},
                        kTreeScale);
    blit1BitTransparent(r, x + 130, baseY - BG_TREE_A_H * kTreeScale + 8, {BG_TREE_A, BG_TREE_A_W, BG_TREE_A_H},
                        kTreeScale);
  } else {
    blit1BitTransparent(r, x + 20, baseY - BG_TREE_B_H * kTreeScale, {BG_TREE_B, BG_TREE_B_W, BG_TREE_B_H},
                        kTreeScale);
    blit1BitTransparent(r, x + 88, baseY - BG_TREE_A_H * kTreeScale + 4, {BG_TREE_A, BG_TREE_A_W, BG_TREE_A_H},
                        kTreeScale);
  }
}

}  // namespace CatRunSprites
